#include <FastLED.h>
#include "DFRobotDFPlayerMini.h"
#include <Wire.h>
#include <Adafruit_GFX.h>
#include <Adafruit_SSD1306.h>
#include <ESP32Servo.h>
// Configuration
#define LED_PIN 21
#define NUM_LEDS 30
#define BRIGHTNESS 100
#define LED_TYPE WS2811
#define COLOR_ORDER GRB
#define START_SWITCH 22
#define SCREEN_WIDTH 128
#define SCREEN_HEIGHT 64
Servo meuServo;
#define SERVO_PIN 19
bool sistemaAtivo = false;
const unsigned char img_molhar[] PROGMEM = {
	0x00, 0x00, 0x00, 0x00, 0x00, 0x00, 0x00, 0x00, 0x00, 0x00, 0x00, 0x00, 0x00, 0x00, 0x00, 0x00,
	0x00, 0x00, 0x00, 0x00, 0x00, 0x00, 0x00, 0x00, 0x00, 0x00, 0x00, 0x00, 0x00, 0x00, 0x00, 0x00,
	0x00, 0x00, 0x00, 0x00, 0x00, 0x00, 0x00, 0x00, 0x00, 0x00, 0x00, 0x00, 0x00, 0x00, 0x00, 0x00,
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	0x00, 0x00, 0x00, 0x00, 0x00, 0x00, 0x00, 0x00, 0x00, 0x00, 0x00, 0x00, 0x00, 0x00, 0x00, 0x00
};
const unsigned char img_sabao[] PROGMEM = {
	0x00, 0x00, 0x00, 0x00, 0x7f, 0xf0, 0x00, 0x00, 0x00, 0x00, 0x00, 0x00, 0x00, 0x00, 0x00, 0x00,
	0x00, 0x00, 0x00, 0x01, 0xe0, 0x7e, 0x00, 0x00, 0x00, 0x00, 0x00, 0x00, 0x00, 0x00, 0x00, 0x00,
	0x00, 0x00, 0x00, 0x03, 0x80, 0x07, 0x00, 0x00, 0x00, 0x00, 0x00, 0x00, 0x00, 0x00, 0x00, 0x00,
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	0x00, 0x00, 0x00, 0x00, 0x00, 0x00, 0x00, 0x00, 0x00, 0x7f, 0xe0, 0x00, 0x00, 0x00, 0x00, 0x00
};
const unsigned char img_esfregar[] PROGMEM = {
	0x00, 0x00, 0x00, 0x00, 0x00, 0x00, 0x00, 0x00, 0x08, 0x00, 0x00, 0x00, 0x00, 0x00, 0x00, 0x00,
	0x00, 0x00, 0x00, 0x00, 0x00, 0x00, 0x00, 0x00, 0x3f, 0x00, 0x00, 0x00, 0x00, 0x00, 0x00, 0x00,
	0x00, 0x0f, 0x00, 0x00, 0x00, 0x00, 0x00, 0x00, 0x61, 0x80, 0x00, 0x00, 0x00, 0x00, 0x00, 0x00,
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	0x7f, 0xff, 0xc0, 0x00, 0x00, 0x00, 0x00, 0x00, 0x00, 0x00, 0x00, 0x00, 0x00, 0x00, 0x00, 0x00

};
const unsigned char img_secar[] PROGMEM = {
	0x00, 0x00, 0x00, 0x00, 0x00, 0x00, 0x00, 0x00, 0x00, 0x00, 0x00, 0x00, 0x00, 0x00, 0x00, 0x00,
	0x00, 0x00, 0x00, 0x00, 0x00, 0x00, 0x00, 0x00, 0x00, 0x00, 0x00, 0x00, 0x00, 0x00, 0x00, 0x00,
	0x00, 0x00, 0x00, 0x00, 0x00, 0x00, 0x00, 0x00, 0x00, 0x00, 0x00, 0x00, 0x00, 0x00, 0x00, 0x00,
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	0x00, 0x00, 0x00, 0x00, 0x00, 0x00, 0x00, 0x00, 0x00, 0x00, 0x00, 0x00, 0x00, 0x00, 0x00, 0x00
};
const unsigned char img_confetes[] PROGMEM = {
	0x00, 0x00, 0x00, 0x00, 0x00, 0x00, 0x03, 0x00, 0x00, 0x00, 0x00, 0x00, 0x00, 0x00, 0x00, 0x00,
	0x00, 0x00, 0x00, 0x00, 0x00, 0x00, 0x07, 0x80, 0x00, 0x08, 0x00, 0x60, 0x70, 0x00, 0x00, 0x00,
	0x00, 0x00, 0x00, 0x00, 0x00, 0x00, 0x0f, 0x80, 0x00, 0x18, 0x00, 0x7f, 0xe0, 0x00, 0x00, 0x00,
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	0x00, 0x00, 0x00, 0x00, 0x00, 0x00, 0x00, 0x00, 0x00, 0x00, 0x00, 0x00, 0x00, 0x00, 0x00, 0x07

};

Adafruit_SSD1306 display(SCREEN_WIDTH, SCREEN_HEIGHT, &Wire, -1);
// Usamos a Serial2 do ESP32 (Pinos 16 e 17)
HardwareSerial somSerial(2);
DFRobotDFPlayerMini myDFPlayer;
// MUDAR PINOS QUANDO FOR USAR A NOSSA BOARD
#define OLED_SCL 27
#define OLED_SDA 14
int etapaAtual = 1;
int pos = 0;
unsigned long ultimoMovimentoServo = 0;
int servoPosition = 90;     // Start at the center position
int servoRange = 35;        // Adjust this value to control the wiggle range
int intervaloWiggle = 100;  // Speed of wiggle (ms)
bool ladoWiggle = false;    // Toggle for left/right
unsigned long tempoInicio;
unsigned long tempoDestaEtapa = 5000;  // isso são 5s

CRGB leds[NUM_LEDS];

void setup() {
	ESP32PWM::allocateTimer(0);
	ESP32PWM::allocateTimer(1);
	ESP32PWM::allocateTimer(2);
	ESP32PWM::allocateTimer(3);
	meuServo.setPeriodHertz(50);  // Standard 50hz servo
	meuServo.attach(SERVO_PIN, 500, 2400);
	// --- Initialize Serial Monitor ---
	Serial.begin(115200);
	Wire.begin(OLED_SDA, OLED_SCL);
	Serial.println("System Initialized. Waiting for button press...");
	// --- Inicialização do Som (DFPlayer) ---
	somSerial.begin(9600, SERIAL_8N1, 16, 17);
	Serial.println("A iniciar DFPlayer...");
	delay(1000);

	pinMode(START_SWITCH, INPUT_PULLUP);

	FastLED.addLeds<LED_TYPE, LED_PIN, COLOR_ORDER>(leds, NUM_LEDS).setCorrection(TypicalLEDStrip);
	FastLED.setBrightness(BRIGHTNESS);
	if (!myDFPlayer.begin(somSerial)) {
		Serial.println("Erro: Não foi possível comunicar com o modulo DFPlayer.");
		// Removi o while(true) para o código não "congelar" aqui se o som falhar
	} else {
		Serial.println("DFPlayer OK! A tocar música...");
	}
	FastLED.clear();
	FastLED.show();
	if (!display.begin(SSD1306_SWITCHCAPVCC, 0x3C)) {
		Serial.println("Erro: SSD1306 não encontrado");
		for (;;)
			;
	}

	display.clearDisplay();
	display.display();
	Serial.println("Ready. Press button to start.");
	tempoInicio = millis();
	meuServo.write(90);
	sistemaAtivo = false;
	Serial.println(sistemaAtivo);
	Serial.println(etapaAtual);
}
void loop() {
	unsigned long tempoAtual = millis();

	// 1. O BOTÃO
	if (digitalRead(START_SWITCH) == LOW && !sistemaAtivo) {
		delay(50);
		sistemaAtivo = true;
		etapaAtual = 1;
		tempoInicio = tempoAtual;
		myDFPlayer.volume(100);
		myDFPlayer.play(1);
	}

	if (sistemaAtivo) {
		unsigned long decorrido = tempoAtual - tempoInicio;
		display.clearDisplay();

		switch (etapaAtual) {
			case 1:
				display.drawBitmap(0, 0, img_molhar, 128, 64, WHITE);
				tempoDestaEtapa = 16000;
				break;
			case 2:
				display.drawBitmap(0, 0, img_sabao, 128, 64, WHITE);
				tempoDestaEtapa = 7000;
				break;
			case 3:
				display.drawBitmap(0, 0, img_esfregar, 128, 64, WHITE);
				tempoDestaEtapa = 20000;
				break;

			case 4:
				display.drawBitmap(0, 0, img_molhar, 128, 64, WHITE);
				tempoDestaEtapa = 14000;
				break;
			case 5:
				display.drawBitmap(0, 0, img_secar, 128, 64, WHITE);
				tempoDestaEtapa = 8000;
				break;
			case 6:
				display.drawBitmap(0, 0, img_confetes, 128, 64, WHITE);
				wiggleServo();
				break;
		}

		// 3. AS LUZES
		if (decorrido < (tempoDestaEtapa * 0.4)) {
			fill_solid(leds, NUM_LEDS, CRGB::Red);
		} else if (decorrido < (tempoDestaEtapa * 0.9)) {
			fill_solid(leds, NUM_LEDS, CRGB::Yellow);
		} else {
			fill_solid(leds, NUM_LEDS, CRGB::Green);
		}

		FastLED.show();
		display.display();
		// 4. MUDANÇA AUTOMÁTICA
		if (decorrido >= tempoDestaEtapa) {
			if (etapaAtual < 6) {
				etapaAtual++;
				tempoInicio = millis();
			} else {
				// --- O SISTEMA TERMINOU AQUI ---
				meuServo.write(90);  // Comando para PARAR (360°) ou CENTRALIZAR (180°)
				FastLED.clear();
				FastLED.show();
				display.clearDisplay();
				display.display();

				sistemaAtivo = false;
				etapaAtual = 0;

				Serial.println("Ciclo finalizado. Servo parado.");
			}
		}
	}
}
void wiggleServo() {
	// Servo spins forward at full speed for 1 second.
	meuServo.write(180);
	delay(500);
	// Servo is stationary for 1 second.
	meuServo.write(90);
	delay(500);
	meuServo.write(180);
	delay(500);
	// Servo is stationary for 1 second.
	meuServo.write(90);
	delay(500);
	meuServo.write(180);
	delay(500);
	// Servo is stationary for 1 second.
	meuServo.write(90);
	delay(500);
	
}
void runColorCycle(unsigned long duration) {
	unsigned long startTime = millis();

	while (millis() - startTime < duration) {
		static uint8_t hue = 0;
		fill_rainbow(leds, NUM_LEDS, hue++, 7);
		FastLED.show();
		delay(20);
	}

	FastLED.clear();
	FastLED.show();
}
