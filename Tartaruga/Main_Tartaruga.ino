#include <FastLED.h>
#include "DFRobotDFPlayerMini.h"
#include <Wire.h>
#include <Adafruit_GFX.h>
#include <Adafruit_SSD1306.h>
#include <ESP32Servo.h>
// Configuration
#define LED_PIN 21
#define NUM_LEDS 40
#define BRIGHTNESS 100
#define LED_TYPE WS2811
#define COLOR_ORDER GRB
#define START_SWITCH 22
#define SCREEN_WIDTH 128
#define SCREEN_HEIGHT 64
Servo meuServo;
#define SERVO_PIN 19
bool sistemaAtivo = false;
const unsigned char img_molhar[] PROGMEM = {
	0x00, 0x00, 0x00, 0x00, 0x00, 0x00, 0x00, 0x00, 0x00, 0x00, 0x00, 0x00, 0x00, 0x00, 0x00, 0x00,
	0x00, 0x00, 0x00, 0x00, 0x00, 0x00, 0x00, 0x00, 0x00, 0x00, 0x00, 0x00, 0x00, 0x00, 0x00, 0x00,
	0x00, 0x00, 0x00, 0x00, 0x00, 0x00, 0x00, 0x00, 0x00, 0x00, 0x00, 0x00, 0x00, 0x00, 0x00, 0x00,
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	0x00, 0x00, 0x00, 0x00, 0x00, 0x00, 0x00, 0x00, 0x00, 0x00, 0x00, 0x00, 0x00, 0x00, 0x00, 0x00
};
const unsigned char img_sabao[] PROGMEM = {
	0x00, 0x00, 0x00, 0x00, 0x7f, 0xf0, 0x00, 0x00, 0x00, 0x00, 0x00, 0x00, 0x00, 0x00, 0x00, 0x00,
	0x00, 0x00, 0x00, 0x01, 0xe0, 0x7e, 0x00, 0x00, 0x00, 0x00, 0x00, 0x00, 0x00, 0x00, 0x00, 0x00,
	0x00, 0x00, 0x00, 0x03, 0x80, 0x07, 0x00, 0x00, 0x00, 0x00, 0x00, 0x00, 0x00, 0x00, 0x00, 0x00,
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	0x00, 0x00, 0x00, 0x00, 0x00, 0x00, 0x00, 0x00, 0x00, 0x7f, 0xe0, 0x00, 0x00, 0x00, 0x00, 0x00
};
const unsigned char img_esfregar[] PROGMEM = {
	0x00, 0x00, 0x00, 0x00, 0x00, 0x00, 0x00, 0x00, 0x08, 0x00, 0x00, 0x00, 0x00, 0x00, 0x00, 0x00,
	0x00, 0x00, 0x00, 0x00, 0x00, 0x00, 0x00, 0x00, 0x3f, 0x00, 0x00, 0x00, 0x00, 0x00, 0x00, 0x00,
	0x00, 0x0f, 0x00, 0x00, 0x00, 0x00, 0x00, 0x00, 0x61, 0x80, 0x00, 0x00, 0x00, 0x00, 0x00, 0x00,
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	0x7f, 0xff, 0xc0, 0x00, 0x00, 0x00, 0x00, 0x00, 0x00, 0x00, 0x00, 0x00, 0x00, 0x00, 0x00, 0x00

};
const unsigned char img_secar[] PROGMEM = {
	0x00, 0x00, 0x00, 0x00, 0x00, 0x00, 0x00, 0x00, 0x00, 0x00, 0x00, 0x00, 0x00, 0x00, 0x00, 0x00,
	0x00, 0x00, 0x00, 0x00, 0x00, 0x00, 0x00, 0x00, 0x00, 0x00, 0x00, 0x00, 0x00, 0x00, 0x00, 0x00,
	0x00, 0x00, 0x00, 0x00, 0x00, 0x00, 0x00, 0x00, 0x00, 0x00, 0x00, 0x00, 0x00, 0x00, 0x00, 0x00,
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	0x00, 0x00, 0x00, 0x00, 0x00, 0x00, 0x00, 0x00, 0x00, 0x00, 0x00, 0x00, 0x00, 0x00, 0x00, 0x00
};
const unsigned char img_confetes[] PROGMEM = {
	0x00, 0x00, 0x00, 0x00, 0x00, 0x00, 0x03, 0x00, 0x00, 0x00, 0x00, 0x00, 0x00, 0x00, 0x00, 0x00,
	0x00, 0x00, 0x00, 0x00, 0x00, 0x00, 0x07, 0x80, 0x00, 0x08, 0x00, 0x60, 0x70, 0x00, 0x00, 0x00,
	0x00, 0x00, 0x00, 0x00, 0x00, 0x00, 0x0f, 0x80, 0x00, 0x18, 0x00, 0x7f, 0xe0, 0x00, 0x00, 0x00,
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	0x00, 0x00, 0x00, 0x00, 0x00, 0x00, 0x00, 0x00, 0x00, 0x00, 0x00, 0x00, 0x00, 0x00, 0x00, 0x07

};
Adafruit_SSD1306 display(SCREEN_WIDTH, SCREEN_HEIGHT, &Wire, -1);
HardwareSerial somSerial(2);
DFRobotDFPlayerMini myDFPlayer;

#define OLED_SCL 27
#define OLED_SDA 14
int etapaAtual = 1;
int pos = 0;
unsigned long ultimoMovimentoServo = 0;
int servoPosition = 90;
int servoRange = 45; 
int intervaloWiggle = 250;
unsigned long tempoInicio;
unsigned long tempoDestaEtapa = 5000;

CRGB leds[NUM_LEDS];

void setup() {
  ESP32PWM::allocateTimer(0);
  ESP32PWM::allocateTimer(1);
  ESP32PWM::allocateTimer(2);
  ESP32PWM::allocateTimer(3);
  meuServo.setPeriodHertz(50);
  meuServo.attach(SERVO_PIN, 500, 2400);

  Serial.begin(115200);
  Wire.begin(OLED_SDA, OLED_SCL);
  
  somSerial.begin(9600, SERIAL_8N1, 16, 17);
  delay(1000);

  pinMode(START_SWITCH, INPUT_PULLUP);

  FastLED.addLeds<LED_TYPE, LED_PIN, COLOR_ORDER>(leds, NUM_LEDS).setCorrection(TypicalLEDStrip);
  FastLED.setBrightness(BRIGHTNESS);
  
  if (myDFPlayer.begin(somSerial)) {
    Serial.println("DFPlayer OK");
  }

  FastLED.clear();
  FastLED.show();
  
  if (!display.begin(SSD1306_SWITCHCAPVCC, 0x3C)) {
    for (;;);
  }

  display.clearDisplay();
  display.display();
  
  tempoInicio = millis();
  sistemaAtivo = false;
}

void loop() {
  unsigned long tempoAtual = millis();

  if (digitalRead(START_SWITCH) == LOW && !sistemaAtivo) {
    delay(50);
    sistemaAtivo = true;
    etapaAtual = 1;
    tempoInicio = tempoAtual;
    myDFPlayer.volume(100);
    myDFPlayer.play(1);
  }

  if (sistemaAtivo) {
    unsigned long decorrido = tempoAtual - tempoInicio;
    display.clearDisplay();
    FastLED.clear();

    int pSize = NUM_LEDS / 5;
    CRGB corAtiva = CRGB::Black;
    int particaoParaLigar = 0;

    switch (etapaAtual) {
      case 1:
        tempoDestaEtapa = 16000;
        display.drawBitmap(0, 0, img_molhar, 128, 64, WHITE);
        corAtiva = CRGB::Blue;
        particaoParaLigar = 1;
        break;
      case 2:
        tempoDestaEtapa = 7000;
        display.drawBitmap(0, 0, img_sabao, 128, 64, WHITE);
        corAtiva = CRGB::Red;
        particaoParaLigar = 2;
        break;
      case 3:
        tempoDestaEtapa = 20000;
        display.drawBitmap(0, 0, img_esfregar, 128, 64, WHITE);
        corAtiva = CRGB::Purple;
        particaoParaLigar = 3;
        break;
      case 4:
        tempoDestaEtapa = 14000;
        display.drawBitmap(0, 0, img_molhar, 128, 64, WHITE);
        corAtiva = CRGB::Yellow;
        particaoParaLigar = 4;
        break;
      case 5:
        tempoDestaEtapa = 8000;
        display.drawBitmap(0, 0, img_secar, 128, 64, WHITE);
        corAtiva = CRGB::Green;
        particaoParaLigar = 5;
        break;
      case 6:
        tempoDestaEtapa = 5000;
        display.drawBitmap(0, 0, img_confetes, 128, 64, WHITE);
        updateServoNonBlocking();
        break;
    }

    if (etapaAtual < 6) {
      int inicio = (particaoParaLigar - 1) * pSize;
      int fim = min(inicio + pSize, (int)NUM_LEDS);
      fill_solid(&leds[inicio], (fim - inicio), corAtiva);

      uint8_t pulse = beatsin8(40, 100, 255);
      for (int i = inicio; i < fim; i++) {
        leds[i].nscale8(pulse);
      }
    } else {
      fill_solid(leds, NUM_LEDS, CRGB::Green);
    }

    FastLED.show();
    display.display();

    if (decorrido >= tempoDestaEtapa) {
      if (etapaAtual < 6) {
        etapaAtual++;
        tempoInicio = millis();
      } else {
        FastLED.clear();
        FastLED.show();
        display.clearDisplay();
        display.display();
        meuServo.write(90);
        sistemaAtivo = false;
        etapaAtual = 0;
      }
    }
  }
}

void updateServoNonBlocking() {
  static unsigned long lastServoMove = 0;
  static bool side = false;
  unsigned long currentMillis = millis();

  if (currentMillis - lastServoMove >= 250) {
    lastServoMove = currentMillis;
    if (side) {
      meuServo.write(135); 
    } else {
      meuServo.write(45);
    }
    side = !side;
  }
}

void runColorCycle(unsigned long duration) {
  unsigned long startTime = millis();
  while (millis() - startTime < duration) {
    static uint8_t hue = 0;
    fill_rainbow(leds, NUM_LEDS, hue++, 7);
    FastLED.show();
    delay(20);
  }
  FastLED.clear();
  FastLED.show();
}
